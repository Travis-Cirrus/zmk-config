## boards/prj.conf
```kconfig
CONFIG_WS2812_STRIP=y
CONFIG_ZMK_RGB_UNDERGLOW=y
CONFIG_ZMK_RGB_UNDERGLOW_WS2812=y

CONFIG_ZMK_RGB_UNDERGLOW_ENABLE_INIT_ON_BOOT=y
CONFIG_ZMK_RGB_UNDERGLOW_DEFAULT_VAL=128
CONFIG_ZMK_RGB_UNDERGLOW_DEFAULT_HUE=180
CONFIG_ZMK_RGB_UNDERGLOW_DEFAULT_SAT=255
CONFIG_ZMK_RGB_UNDERGLOW_DEFAULT_MODE="breathing"

# Optional but recommended:
CONFIG_ZMK_RGB_UNDERGLOW_MAX_BRIGHTNESS=180
```
