/
 {
    led_strip: ws2812b {
        compatible = "worldsemi,ws2812";
        label = "WS2812B";
        gpios = <&gpio1 5 GPIO_ACTIVE_HIGH>; // P1.05 = B5
        chain-length = <27>;
        color-order = <0 1 2>; // GRB
        status = "okay";
    };

    chosen {
        zmk,underglow = &led_strip;
    };
};
